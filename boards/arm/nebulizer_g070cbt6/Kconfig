## boards/arm/nebulizer_g070cbt6/Kconfig.defconfig
```kconfig
if BOARD_NEBULIZER_G070CBT6

config GPIO
	default y

config SERIAL
	default y

config UART_INTERRUPT_DRIVEN
	default y

config CONSOLE
	default y

config UART_CONSOLE
	default y

config ADC
	default y

config PWM
	default y

config COUNTER
	default y

config I2C
	default y

config CLOCK_CONTROL
	default y

endif
```

## boards/arm/nebulizer_g070cbt6/board.yml
```yaml
board:
  name: nebulizer_g070cbt6
  full_name: 9C Nebulizer STM32G070CBT6
  vendor: 9c
  socs:
    - name: stm32g070xx
```
